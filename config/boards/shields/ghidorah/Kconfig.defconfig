## config/boards/shields/ghidorah/Kconfig.defconfig
```kconfig
if SHIELD_GHIDORAH_MIDDLE

config ZMK_KEYBOARD_NAME
    default "Ghidorah"

config ZMK_SPLIT_ROLE_CENTRAL
    default y

endif

if SHIELD_GHIDORAH_MIDDLE || SHIELD_GHIDORAH_RIGHT || SHIELD_GHIDORAH_KEVIN

config ZMK_SPLIT
    default y

endif
```

## config/boards/shields/ghidorah/Kconfig.shield
```kconfig
config SHIELD_GHIDORAH_MIDDLE
    def_bool $(shields_list_contains,ghidorah_middle)

config SHIELD_GHIDORAH_RIGHT
    def_bool $(shields_list_contains,ghidorah_right)

config SHIELD_GHIDORAH_KEVIN
    def_bool $(shields_list_contains,ghidorah_kevin)
```

## config/boards/shields/lopro_cosmos/Kconfig.defconfig
```kconfig
if SHIELD_LOPRO_COSMOS_LEFT

config ZMK_KEYBOARD_NAME
    default "LoPro Cosmos"

config ZMK_SPLIT_ROLE_CENTRAL
    default y

endif

if SHIELD_LOPRO_COSMOS_LEFT || SHIELD_LOPRO_COSMOS_RIGHT || SHIELD_LOPRO_COSMOS_LEFT_PERIPHERAL

config ZMK_SPLIT
    default y

endif
```
