## config/boards/shields/lopro_cosmos/Kconfig.shield
```kconfig
config SHIELD_LOPRO_COSMOS_LEFT
    def_bool $(shields_list_contains,lopro_cosmos_left)

config SHIELD_LOPRO_COSMOS_RIGHT
    def_bool $(shields_list_contains,lopro_cosmos_right)

config SHIELD_LOPRO_COSMOS_CENTRAL
    def_bool $(shields_list_contains,lopro_cosmos_central)
```

## config/boards/shields/lopro_cosmos_central/Kconfig.defconfig
```kconfig
if SHIELD_LOPRO_COSMOS_CENTRAL

config ZMK_KEYBOARD_NAME
    default "LoPro Cosmos Central"

config ZMK_SPLIT
    default y

config ZMK_SPLIT_ROLE_CENTRAL
    default y

# No matrix scanning on the central
config ZMK_KSCAN
    default n

endif
```

## config/boards/shields/lopro_cosmos_central/Kconfig.shield
```kconfig
config SHIELD_LOPRO_COSMOS_CENTRAL
    def_bool $(shields_list_contains,lopro_cosmos_central)
```

## config/lopro_cosmos/Kconfig.defconfig
```kconfig
if SHIELD_LOPRO_COSMOS_LEFT

config ZMK_KEYBOARD_NAME
    default "LoPro Cosmos"

config ZMK_SPLIT_ROLE_CENTRAL
    default y

endif

if SHIELD_LOPRO_COSMOS_LEFT || SHIELD_LOPRO_COSMOS_RIGHT

config ZMK_SPLIT
    default y

endif
```

## config/west.yml
```yaml
manifest:
  remotes:
    - name: zmkfirmware
      url-base: https://github.com/zmkfirmware

  projects:
    - name: zmk
      remote: zmkfirmware
      revision: main
      import: app/west.yml

    - name: lopro_cosmos
      path: ..

  self:
    path: config
    west-commands: ../
```
